## config/boards/shields/nilsers54/Kconfig.defconfig
```kconfig
if SHIELD_NILSERS54_LEFT

config ZMK_KEYBOARD_NAME
    default "nilsers54"

endif


if SHIELD_NILSERS54_LEFT || SHIELD_NILSERS54_RIGHT

config ZMK_SPLIT
    default y

endif
```

## config/boards/shields/nilsers54/Kconfig.shield
```kconfig
config SHIELD_NILSERS54_LEFT
    def_bool $(shields_list_contains, nilsers54_left)

config SHIELD_NILSERS54_RIGHT
    def_bool $(shields_list_contains, nilsers54_right)
```
